#include "SAC6010.h"
#include "usart.h"
#include "gpio.h"


float coils_current[8];
int coils_power =  0;


// current:要转换的电流， current_scale:电流范围(+, -), pulse_scale: pwm占空比范围，精度
uint32_t calculate_current_to_pwm(float current, float current_scale, uint32_t pulse_scale)
{
	uint32_t output_pulse = 0;

	float current_pulse_relation = 0;
	
	current_pulse_relation = (pulse_scale/2.0)/current_scale; // 电流转占空比，系数
	
	output_pulse = (uint32_t)((pulse_scale/2.0) + current*current_pulse_relation);

	
	return output_pulse;
	
}

void sac6010_set_output(char address, float current)
{

	uint16_t crc;
	int32_t current_data = (int32_t)(current*1000);
	//uint16_t crc;
	uint8_t send_list[13];


	send_list[0] = address;
	send_list[1] = 0x10;
	send_list[2] = 0x20;
	send_list[3] = 0x30;
	send_list[4] = 0x00;
	send_list[5] = 0x02;
	send_list[6] = 0x04;
	send_list[7] = (current_data >> 24) & 0XFF;
	send_list[8] = (current_data >> 16) & 0XFF;
	send_list[9] = (current_data >> 8) & 0XFF;
	send_list[10]= (current_data) & 0XFF;

	crc = crc16((uint8_t *)send_list, 11);

	send_list[11]= (crc >> 8) & 0XFF;
	send_list[12]= (crc) & 0XFF;
	
	HAL_GPIO_WritePin(GPIOA, GPIO_PIN_8, GPIO_PIN_SET);
	//HAL_UART_Transmit_DMA(&huart1, (uint8_t *)send_list, sizeof(send_list));
	HAL_UART_Transmit(&huart1, (uint8_t *)send_list, sizeof(send_list),1500);
	HAL_GPIO_WritePin(GPIOA, GPIO_PIN_8, GPIO_PIN_RESET);
}

void sac6010_set_current_mode(char address)
{

	uint16_t crc;
	uint8_t send_list[8];

	send_list[0] = address;
	send_list[1] = 0x06;
	send_list[2] = 0x60;
	send_list[3] = 0x60;
	send_list[4] = 0xff;
	send_list[5] = 0xfd;
	crc = crc16((uint8_t *)send_list, 6);
	send_list[6] = (crc >> 8) & 0XFF;
	send_list[7] = (crc) & 0XFF;
	HAL_GPIO_WritePin(GPIOA, GPIO_PIN_8, GPIO_PIN_SET);
	HAL_UART_Transmit(&huart1, (uint8_t *)send_list, sizeof(send_list),1500);
	HAL_GPIO_WritePin(GPIOA, GPIO_PIN_8, GPIO_PIN_RESET);
}

void sac6010_open_output(char address)
{

	uint16_t crc;
	uint8_t send_list[8];

	send_list[0] = address;
	send_list[1] = 0x06;
	send_list[2] = 0x60;
	send_list[3] = 0x40;
	send_list[4] = 0x00;
	send_list[5] = 0xff;
	crc = crc16((uint8_t *)send_list, 6);
	send_list[6] = (crc >> 8) & 0XFF;
	send_list[7] = (crc) & 0XFF;
	HAL_GPIO_WritePin(GPIOA, GPIO_PIN_8, GPIO_PIN_SET);
	HAL_UART_Transmit(&huart1, (uint8_t *)send_list, sizeof(send_list),1500);
	HAL_GPIO_WritePin(GPIOA, GPIO_PIN_8, GPIO_PIN_RESET);
}

void sac6010_close_output(char address)
{

	uint16_t crc;
	uint8_t send_list[8];

	send_list[0] = address;
	send_list[1] = 0x06;
	send_list[2] = 0x60;
	send_list[3] = 0x40;
	send_list[4] = 0x00;
	send_list[5] = 0x00;
	crc = crc16((uint8_t *)send_list, 6);
	send_list[6] = (crc >> 8) & 0XFF;
	send_list[7] = (crc) & 0XFF;
	HAL_GPIO_WritePin(GPIOA, GPIO_PIN_8, GPIO_PIN_SET);
	HAL_UART_Transmit(&huart1, (uint8_t *)send_list, sizeof(send_list),1500);
	HAL_GPIO_WritePin(GPIOA, GPIO_PIN_8, GPIO_PIN_RESET);
}

/* 接收来自上位机的数据 */




void sac6010_read_open_output(uint8_t* send_list)
{

	uint16_t crc;

	crc = crc16((uint8_t *)send_list, 6);
	
	if((send_list[6] == ((crc >> 8) & 0XFF)) && (send_list[7] == ((crc) & 0XFF)))
	{
		coils_power = 1;
	}
}

void sac6010_read_close_output(uint8_t* send_list)
{

	uint16_t crc;

	crc = crc16((uint8_t *)send_list, 6);
	
	if((send_list[6] == ((crc >> 8) & 0XFF)) && (send_list[7] == ((crc) & 0XFF)))
	{
		coils_power = 0;
	}

}

void sac6010_read_set_output(uint8_t* send_list)
{

	uint16_t crc;
	float current = 0;
	
	uint8_t address = send_list[0];
	
	int32_t current_data = ((int32_t)send_list[7] << 24) | ((int32_t)send_list[8] << 16) | ((int32_t)send_list[9] << 8) | ((int32_t)send_list[10]);


	crc = crc16((uint8_t *)send_list, 11);

	if((send_list[11] == ((crc >> 8) & 0XFF)) && (send_list[12] == ((crc) & 0XFF)))
	{
		current = current_data/1000.0f;
		coils_current[address-1] = current;
	}
	
}


void sac6010_read_set_multi__output(uint8_t* send_list)
{

	uint16_t crc;
	int32_t current_data[8];
	
	
	uint8_t address = send_list[0];
	
	current_data[0] = ((int32_t)send_list[7] << 24) | ((int32_t)send_list[8] << 16) | ((int32_t)send_list[9] << 8) | ((int32_t)send_list[10]);
	current_data[1] = ((int32_t)send_list[11] << 24) | ((int32_t)send_list[12] << 16) | ((int32_t)send_list[13] << 8) | ((int32_t)send_list[14]);
	current_data[2] = ((int32_t)send_list[15] << 24) | ((int32_t)send_list[16] << 16) | ((int32_t)send_list[17] << 8) | ((int32_t)send_list[18]);
	current_data[3] = ((int32_t)send_list[19] << 24) | ((int32_t)send_list[20] << 16) | ((int32_t)send_list[21] << 8) | ((int32_t)send_list[22]);
	current_data[4] = ((int32_t)send_list[23] << 24) | ((int32_t)send_list[24] << 16) | ((int32_t)send_list[25] << 8) | ((int32_t)send_list[26]);
	current_data[5] = ((int32_t)send_list[27] << 24) | ((int32_t)send_list[28] << 16) | ((int32_t)send_list[29] << 8) | ((int32_t)send_list[30]);
	current_data[6] = ((int32_t)send_list[31] << 24) | ((int32_t)send_list[32] << 16) | ((int32_t)send_list[33] << 8) | ((int32_t)send_list[34]);
	current_data[7] = ((int32_t)send_list[35] << 24) | ((int32_t)send_list[36] << 16) | ((int32_t)send_list[37] << 8) | ((int32_t)send_list[38]);


	crc = crc16((uint8_t *)send_list, 39);

	if((send_list[39] == ((crc >> 8) & 0XFF)) && (send_list[40] == ((crc) & 0XFF)))
	{
		for(int i=0;i<8;i++)
		{
			coils_current[i] = current_data[i]/1000.0f;
		}
	}
}


int cnt = 0;

void sac6010_read_from_pc(uint8_t* send_list)
{
	cnt +=1;
	
	if(send_list[1] == 0x06 && send_list[2] == 0x60 && send_list[3] == 0x40 && send_list[4] == 0x00 && send_list[5] == 0xff)
	{
		sac6010_read_open_output(send_list);
	}
	else if(send_list[1] == 0x06 && send_list[2] == 0x60 && send_list[3] == 0x40 && send_list[4] == 0x00 && send_list[5] == 0x00)
	{
		sac6010_read_close_output(send_list);
	}
	else if(send_list[1] == 0x10 && send_list[2] == 0x20 && send_list[3] == 0x30 && send_list[4] == 0x00 && send_list[5] == 0x02 && send_list[6] == 0x04)
	{
		sac6010_read_set_output(send_list);
	}
	else if(send_list[1] == 0x10 && send_list[2] == 0x20 && send_list[3] == 0x30 && send_list[4] == 0x00 && send_list[5] == 0x02 && send_list[6] == 0x05)
	{
		sac6010_read_set_multi__output(send_list);
	}	
}




uint16_t crc16(uint8_t *buffer, uint16_t buffer_length)
{
    /* Table of CRC values for high-order byte */
    static unsigned char table_crc_hi[] = {
        0x00, 0xC1, 0x81, 0x40, 0x01, 0xC0, 0x80, 0x41, 0x01, 0xC0,
        0x80, 0x41, 0x00, 0xC1, 0x81, 0x40, 0x01, 0xC0, 0x80, 0x41,
        0x00, 0xC1, 0x81, 0x40, 0x00, 0xC1, 0x81, 0x40, 0x01, 0xC0,
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        0x80, 0x41, 0x00, 0xC1, 0x81, 0x40
    };

    /* Table of CRC values for low-order byte */
    static unsigned char table_crc_lo[] = {
        0x00, 0xC0, 0xC1, 0x01, 0xC3, 0x03, 0x02, 0xC2, 0xC6, 0x06,
        0x07, 0xC7, 0x05, 0xC5, 0xC4, 0x04, 0xCC, 0x0C, 0x0D, 0xCD,
        0x0F, 0xCF, 0xCE, 0x0E, 0x0A, 0xCA, 0xCB, 0x0B, 0xC9, 0x09,
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        0x43, 0x83, 0x41, 0x81, 0x80, 0x40
    };

		unsigned char crc_hi = 0xFF;
		unsigned char crc_lo = 0xFF;
		unsigned int i;
		


    /* pass through message buffer */
    while (buffer_length--) {
        i = crc_hi ^ *buffer++; /* calculate the CRC  */
        crc_hi = crc_lo ^ table_crc_hi[i];
        crc_lo = table_crc_lo[i];
    }

    return crc_hi << 8 | crc_lo;
}
